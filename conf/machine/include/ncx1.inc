## conf/machine/include/ncx1.inc
```bitbake
# Microchip SAM9X60 defaults
require ncx1sam9.inc

SOC_FAMILY = "at91sam9:sam9x60"
```

## conf/machine/ncx1.conf
```bitbake
#@TYPE: Machine
#@Name: CABSY NCX1
#@DESCRIPTION: Machine configuration for CABSY NCX1

require include/sam9x60.inc

MACHINE_FEATURES = "apm alsa ext2 ext3 usbhost usbgadget screen touchscreen"
KERNEL_DEVICETREE = " sam9-ncx1.dtb "

IMAGE_FSTYPES += " tar.gz wic"

do_image_wic[depends] += "u-boot-at91-ncx1:do_deploy"
WKS_FILE = "sdimage-bootpart.wks"

IMAGE_BOOT_FILES = "BOOT.BIN u-boot.bin uboot.env sam9-ncx1.itb"
UBOOT_MACHINE ?= "ncx1_mmc_defconfig"
UBOOT_ENTRYPOINT = "0x20008000"
UBOOT_LOADADDRESS = "0x20008000"
UBOOT_ENV_SIZE = "0x4000"

AT91BOOTSTRAP_MACHINE ?= "ncx1"

# Needed for wic
EXTRA_IMAGEDEPENDS += "dosfstools-native mtools-native"

# Needed for FIT
MACHINE_ESSENTIAL_EXTRA_RDEPENDS = " dt-overlay-at91"
```
